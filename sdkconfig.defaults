## sdkconfig.defaults
```kconfig
CONFIG_IDF_TARGET="esp32s3"
CONFIG_ESPTOOLPY_FLASHSIZE_8MB=y
CONFIG_PARTITION_TABLE_CUSTOM=y
CONFIG_PARTITION_TABLE_CUSTOM_FILENAME="partitions.csv"
CONFIG_BOOTLOADER_APP_ROLLBACK_ENABLE=y
CONFIG_TINYUSB_NET_MODE_NCM=y
CONFIG_ESP_TASK_WDT_PANIC=y
CONFIG_HTTPD_MAX_REQ_HDR_LEN=1024
CONFIG_LWIP_IGMP=y
CONFIG_COMPILER_CXX_EXCEPTIONS=n
CONFIG_TINYUSB_DESC_MANUFACTURER_STRING="EthAir"
CONFIG_TINYUSB_DESC_PRODUCT_STRING="EthAir USB Ethernet"
CONFIG_TINYUSB_NCM_IN_NTB_BUFFS_COUNT=4
CONFIG_TINYUSB_NCM_OUT_NTB_BUFFS_COUNT=4
CONFIG_LWIP_DHCPS=y
CONFIG_ESP_CONSOLE_SECONDARY_NONE=y
CONFIG_LWIP_MAX_SOCKETS=16
```
